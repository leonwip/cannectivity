## app/boards/ubiquitous_waddle_stm32g0b1xx.conf
```kconfig
# Copyright (c) 2025 leonwip
# SPDX-License-Identifier: Apache-2.0

CONFIG_CANNECTIVITY_USB_SELF_POWERED=n
```

## app/sysbuild/mcuboot/boards/ubiquitous_waddle_stm32g0b1xx.conf
```kconfig
# Copyright (c) 2025 leonwip
# SPDX-License-Identifier: Apache-2.0

CONFIG_BOOT_USB_DFU_GPIO=y
CONFIG_IMG_ERASE_PROGRESSIVELY=y
CONFIG_USB_DFU_DEFAULT_POLLTIMEOUT=10
```
